## world/diffs/kconfig.diff
```kconfig
--- Arch PKGBUILD
+++ Artix PKGBUILD
@@ -1,19 +1,25 @@
 
 pkgname=kconfig
-pkgver=5.110.0
+pkgver=6.0.0
 pkgrel=1
 pkgdesc='Configuration system'
 arch=(x86_64)
 url='https://community.kde.org/Frameworks'
-license=(LGPL)
-depends=(qt5-base)
-makedepends=(extra-cmake-modules qt5-declarative qt5-tools qt5-doc clang doxygen)
-optdepends=('qt5-declarative: QML bindings')
-groups=(kf5)
+license=(LGPL-2.0-only LGPL-3.0-only)
+depends=(gcc-libs
+         glibc
+         qt6-base
+         qt6-declarative)
+makedepends=(doxygen
+             extra-cmake-modules
+             qt6-doc
+             qt6-tools)
+groups=(kf6)
 source=(https://download.kde.org/stable/frameworks/${pkgver%.*}/$pkgname-$pkgver.tar.xz{,.sig})
-sha256sums=('ad2b88bdbb788ed0df5cbdc95ebd24c197d0fee35c08f78acf3e2398016c31c5'
+sha256sums=('3f7c1e6b048df4ab3d67fbef01a5ad1dd0289c9b158644668fba0225c050c050'
             'SKIP')
-validpgpkeys=(53E6B47B45CEA3E0D5B7457758D0EE648A48B3BB) # David Faure <faure@kde.org>
+validpgpkeys=(53E6B47B45CEA3E0D5B7457758D0EE648A48B3BB  # David Faure <faure@kde.org>
+              E0A3EB202F8E57528E13E72FD7574483BB57B18D) # Jonathan Esk-Riddell <jr@jriddell.org>
 
 build() {
   cmake -B build -S $pkgname-$pkgver \


############# Stripped diff below #################

--- Arch PKGBUILD
+++ Artix PKGBUILD
@@ -1,6 +1,9 @@
 pkgname=kconfig
-depends=(qt5-base)
-groups=(kf5)
+depends=(gcc-libs
+glibc
+qt6-base
+qt6-declarative)
+groups=(kf6)
 build() {
 cmake -B build -S $pkgname-$pkgver \
 -DCMAKE_INSTALL_LIBEXECDIR=lib \
```
